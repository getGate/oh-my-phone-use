## components/bt_stack/Kconfig
```kconfig
menu "PhoneUse: Bluetooth stack"

    config PHONEUSE_BT_KEEP_CLASSIC
        bool "Keep the Classic BT (BR/EDR) controller running (needed for HFP)"
        default n
        depends on BTDM_CTRL_MODE_BTDM || BTDM_CTRL_MODE_BR_EDR_ONLY
        help
            Off: the Classic BT controller memory is released at boot and the controller
            runs BLE-only (more free RAM, fewer moving parts) - the right choice while only
            BLE HID is used.
            On: the controller runs in dual mode so a Classic BT profile such as HFP can be
            started next to BLE HID. Also enable CONFIG_BT_CLASSIC_ENABLED and the profile's
            own options; coexistence of BLE HID and HFP has not been validated yet.
            On with CONFIG_BT_BLE_ENABLED=n: the controller runs Classic BT only and the BLE
            controller memory is released (the HFP call audio test, see sdkconfig.hfp_test).
            PHONEUSE_HFP_ENABLE selects this option.

endmenu
```

## components/net/Kconfig
```kconfig
menu "PhoneUse: Wi-Fi"

    config PHONEUSE_WIFI_SSID
        string "Default Wi-Fi SSID (empty: provision over serial)"
        default ""
        help
            Used only when no credentials are stored in NVS. Credentials set with the
            WIFI <ssid> <password> serial command take precedence and survive reflashing.

    config PHONEUSE_WIFI_PASSWORD
        string "Default Wi-Fi password"
        default ""

    config PHONEUSE_WIFI_HOSTNAME
        string "Hostname (DHCP and mDNS: <hostname>.local)"
        default "phoneuse"

    config PHONEUSE_WIFI_MDNS
        bool "Advertise the input tool with mDNS/Bonjour"
        default y
        help
            Lets the iPad app use http://<hostname>.local instead of an IP address.

    config PHONEUSE_WIFI_POWER_SAVE
        bool "Keep Wi-Fi modem sleep enabled (recommended with Bluetooth coexistence)"
        default y
        help
            Modem sleep (WIFI_PS_MIN_MODEM) is what the ESP32 software coexistence
            expects; disabling it (WIFI_PS_NONE) can lower HTTP latency slightly but
            takes airtime away from the Bluetooth LE HID link.

    config PHONEUSE_WIFI_MAX_RETRY_DELAY_S
        int "Longest delay between reconnection attempts (s)"
        range 1 300
        default 30

endmenu
```

## firmware/components/hfp/Kconfig
```kconfig
menu "PhoneUse: HFP call audio"

    config PHONEUSE_HFP_ENABLE
        bool "Enable the hands-free unit (call control and call audio over Classic Bluetooth)"
        default n
        depends on BT_CLASSIC_ENABLED && BT_HFP_CLIENT_ENABLE
        depends on BT_HFP_AUDIO_DATA_PATH_HCI && BT_HFP_USE_EXTERNAL_CODEC
        select PHONEUSE_BT_KEEP_CLASSIC
        help
            The board connects to the iPhone as a car kit (HFP hands-free unit). The serial
            commands CALL, DIAL, ANSWER, HANGUP and AUDIO control calls, and the call audio
            (CVSD, 8 kHz) goes to the host as "A <base64 mu-law>" lines.

            Needs the HCI audio data path in the controller and in Bluedroid, and the external
            codec API. Disable CONFIG_BT_HFP_WBS_ENABLE: this firmware handles CVSD only.
            sdkconfig.hfp_test holds a complete configuration for the call audio test.

    config PHONEUSE_HFP_DEVICE_NAME
        string "Classic Bluetooth name shown on the iPhone"
        default "Oh My Phone Use Audio"
        depends on PHONEUSE_HFP_ENABLE

endmenu
```

## firmware/components/hid/Kconfig
```kconfig
menu "PhoneUse: HID device"

    config PHONEUSE_HID_ENABLE
        bool "Enable the Bluetooth LE HID mouse + keyboard"
        default y
        depends on BT_BLE_ENABLED
        help
            Off: the HID commands stay in the protocol but answer "ERR not_connected", and no
            BLE HID device is advertised. Used by the HFP call audio test (sdkconfig.hfp_test),
            which runs the controller in Classic BT only mode.

    config PHONEUSE_HID_DEVICE_NAME
        string "Bluetooth device name shown on the iPhone"
        default "Oh My Phone Use HID"
        help
            Advertised in the scan response and used for the GAP device name.
            Keep it short (<= 20 characters) so it fits in the scan response.

    config PHONEUSE_HID_REPORT_INTERVAL_MS
        int "Minimum gap between consecutive HID reports (ms)"
        range 0 100
        default 8
        help
            Delay inserted after every input report (each step of a split MOVE, each
            key press and release). Keeps the BLE link from congesting and gives the
            host a steady, predictable event rate. 0 disables the delay.

    config PHONEUSE_HID_MOUSE_MAX_STEP
        int "Largest relative mouse delta sent in one report"
        range 1 127
        default 127
        help
            hid_move()/hid_scroll() split larger movements into several reports of at
            most this size. iOS applies pointer acceleration per report, so smaller
            steps give slower but more linear pointer travel.

    config PHONEUSE_HID_BLE_MITM
        bool "Require authenticated (MITM) pairing with numeric comparison"
        default n
        help
            Off: "Just Works" LE Secure Connections bonding - the iPhone shows a plain
            pairing prompt. This is what the iOS-tested reference projects use.
            On: numeric-comparison pairing; the iPhone shows a 6-digit code which this
            firmware auto-confirms. Try this if a future iOS version refuses unauthenticated
            HID pairing.

endmenu
```

## firmware/components/input_tool/Kconfig
```kconfig
menu "PhoneUse: input tool (iPad Computer Use over Wi-Fi)"

    config PHONEUSE_INPUT_TOOL_ENABLE
        bool "Enable the Wi-Fi HTTP input-tool protocol"
        default y
        help
            Runs a Wi-Fi station and an HTTP server that speak the iPad Computer Use
            input-device protocol (GET /status, POST /input, POST /stop) and play the
            received records back over Bluetooth LE HID. Disable to build the serial-only
            BLE HID firmware (no Wi-Fi, smaller binary, more free RAM).

    if PHONEUSE_INPUT_TOOL_ENABLE

        config PHONEUSE_INPUT_TOOL_HTTP_PORT
            int "HTTP port"
            range 1 65535
            default 80

        config PHONEUSE_INPUT_TOOL_SECRET
            string "Build-time input-device secret (empty: provision over serial)"
            default ""
            help
                Value of the X-Input-Device-Secret header that POST /input and POST /stop
                must carry. The iPad Computer Use control server generates it in
                host/control_server/.state/input_device_secret. A secret stored with the
                SECRET serial command (kept in NVS) takes precedence over this value.

        config PHONEUSE_INPUT_TOOL_RECORD_GAP_MS
            int "Spacing between consecutive records (ms)"
            range 0 200
            default 15
            help
                The XIAO RP2040 reference firmware waits 15 ms after every record. The
                HID report interval (PHONEUSE_HID_REPORT_INTERVAL_MS) counts towards this
                value; only the remainder is added as an extra delay.

        config PHONEUSE_INPUT_TOOL_KEY_HOLD_MS
            int "How long a key record holds its key (ms)"
            range 1 200
            default 15

        config PHONEUSE_INPUT_TOOL_DEADLINE_S
            int "Batch deadline (s)"
            range 1 600
            default 70
            help
                A batch still running after this long is stopped and every key/button
                released, like the reference firmware's 70-second deadline.

        config PHONEUSE_INPUT_TOOL_BOOT_BUTTON
            bool "BOOT button sends a left click"
            default y
            help
                iOS asks you to press a button on the pointing device when assigning
                AssistiveTouch actions to it. Pressing BOOT while the tool is idle sends
                one left click, like the BOOT button of the XIAO reference firmware.

        config PHONEUSE_INPUT_TOOL_BOOT_BUTTON_GPIO
            int "BOOT button GPIO"
            depends on PHONEUSE_INPUT_TOOL_BOOT_BUTTON
            range 0 39
            default 0

    endif

endmenu
```
